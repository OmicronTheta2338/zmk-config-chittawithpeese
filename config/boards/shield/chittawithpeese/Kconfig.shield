## config/boards/shield/chittawithpeese/Kconfig.shield
```kconfig
config SHIELD_CHITTAWITHPEESE
    def_bool $(shields_lists_constains, chittawithpeese)
```

## config/boards/shields/chittawithpeese/Kconfig.defconfig
```kconfig
if SHIELD_CHITTAWITHPEESE

config ZMK_KEYBOARD_NAME
    default "chittawithpeese"

endif
```

## config/boards/shields/chittawithpeese/Kconfig.shield
```kconfig
config SHIELD_CHITTAWITHPEESE
    def_bool $(shields_list_contains,chittawithpeese)
```
